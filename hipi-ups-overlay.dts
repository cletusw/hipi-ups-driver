/dts-v1/;
/plugin/;

/ {
    compatible = "brcm,bcm2835";

    fragment@0 {
        target-path = "/";
        __overlay__ {
            hipi_ups {
                compatible = "custom,hipi-ups";
                power-gpios = <&gpio 17 0>;  /* 17 = Pin, 0 = Active High */
                status-gpios = <&gpio 18 0>; /* 18 = Pin, 0 = Active High */
                online-gpios = <&gpio 27 0>; /* 27 = Pin, 0 = Active High */

                status = "okay";
            };
        };
    };
};
